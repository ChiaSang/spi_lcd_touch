## components/touch_calib/Kconfig.projbuild
```kconfig
menu "Touch Calibration"

    config EXAMPLE_TOUCH_CALIB_ENABLE
        bool "Enable touch auto calibration"
        default y
        help
            Enable calibration pipeline, NVS persistence and runtime calibration matrix.

    config EXAMPLE_TOUCH_CALIB_FORCE_ON_BOOT
        bool "Force calibration wizard on boot"
        depends on EXAMPLE_TOUCH_CALIB_ENABLE
        default n
        help
            Always enter calibration wizard after boot.

    config EXAMPLE_TOUCH_CALIB_POINTS
        int "Calibration points count"
        depends on EXAMPLE_TOUCH_CALIB_ENABLE
        range 3 5
        default 5
        help
            Number of target points used by calibration wizard. Supported values are 3 or 5.

    config EXAMPLE_TOUCH_CALIB_SAMPLES_PER_POINT
        int "Samples per calibration point"
        depends on EXAMPLE_TOUCH_CALIB_ENABLE
        range 3 20
        default 10
        help
            Number of raw samples collected while touching one target.

    config EXAMPLE_TOUCH_CALIB_MAX_ERR_PX
        int "Maximum acceptable calibration error (pixel)"
        depends on EXAMPLE_TOUCH_CALIB_ENABLE
        range 2 60
        default 18
        help
            Calibration is rejected if max fitting error is above this threshold.

    config EXAMPLE_TOUCH_CALIB_UART_CMD
        bool "Enable UART calibration commands"
        depends on EXAMPLE_TOUCH_CALIB_ENABLE
        default y
        help
            Enable runtime command listener for: calib, calib erase, calib status.

endmenu
```

## main/Kconfig.projbuild
```kconfig
menu "Example Configuration"

    config EXAMPLE_LCD_TOUCH_ENABLED
        bool "Enable LCD touch"
        default n
        help
            Enable this option if you wish to use display touch. You can select from touch controllers.

    choice EXAMPLE_LCD_TOUCH_CONTROLLER
        prompt "LCD touch controller model"
        depends on EXAMPLE_LCD_TOUCH_ENABLED
        default EXAMPLE_LCD_TOUCH_CONTROLLER_STMPE610
        help
            Select LCD touch controller model

        config EXAMPLE_LCD_TOUCH_CONTROLLER_STMPE610
            bool "STMPE610"
            help
                Touch controller STMPE610 connected via SPI.

        config EXAMPLE_LCD_TOUCH_CONTROLLER_XPT2046
            bool "XPT2046"
            help
                Touch controller XPT2046 connected via SPI.
    endchoice

    config EXAMPLE_LCD_MIRROR_Y
        int
        default 1 if EXAMPLE_LCD_TOUCH_ENABLED && EXAMPLE_LCD_TOUCH_CONTROLLER_XPT2046
        default 0
        help
            This value is 1 if XPT2046 touch controller is selected, 0 otherwise.

    config EXAMPLE_TOUCH_CALIB_ENABLE
        bool "Enable touch auto calibration"
        depends on EXAMPLE_LCD_TOUCH_ENABLED
        default y
        help
            Enable calibration pipeline, NVS persistence and runtime calibration matrix.

    config EXAMPLE_TOUCH_CALIB_FORCE_ON_BOOT
        bool "Force calibration wizard on boot"
        depends on EXAMPLE_TOUCH_CALIB_ENABLE
        default n
        help
            Always enter calibration wizard after boot.

    config EXAMPLE_TOUCH_CALIB_POINTS
        int "Calibration points count"
        depends on EXAMPLE_TOUCH_CALIB_ENABLE
        range 3 5
        default 5
        help
            Number of target points used by calibration wizard. Supported values are 3 or 5.

    config EXAMPLE_TOUCH_CALIB_SAMPLES_PER_POINT
        int "Samples per calibration point"
        depends on EXAMPLE_TOUCH_CALIB_ENABLE
        range 3 20
        default 10
        help
            Number of raw samples collected while touching one target.

    config EXAMPLE_TOUCH_CALIB_MAX_ERR_PX
        int "Maximum acceptable calibration error (pixel)"
        depends on EXAMPLE_TOUCH_CALIB_ENABLE
        range 2 60
        default 18
        help
            Calibration is rejected if max fitting error is above this threshold.

    config EXAMPLE_TOUCH_CALIB_UART_CMD
        bool "Enable UART calibration commands"
        depends on EXAMPLE_TOUCH_CALIB_ENABLE
        default y
        help
            Enable runtime command listener for: calib, calib erase, calib status.

endmenu
```

## sdkconfig.defaults
```kconfig
CONFIG_LV_CONF_SKIP=y
CONFIG_LV_USE_OBSERVER=y
CONFIG_LV_USE_SYSMON=y
CONFIG_LV_USE_PERF_MONITOR=y
CONFIG_EXAMPLE_LCD_TOUCH_ENABLED=y
CONFIG_EXAMPLE_LCD_TOUCH_CONTROLLER_XPT2046=y
```
